## boards/shields/totemish/Kconfig.defconfig
```kconfig
if SHIELD_TOTEMish_DONGLE

config ZMK_KEYBOARD_NAME
    default "TOTEMish"

config ZMK_SPLIT_ROLE_CENTRAL
    default y

config ZMK_SPLIT
    default y

endif




if SHIELD_TOTEMish_LEFT || SHIELD_TOTEMish_RIGHT || SHIELD_TOTEMish_DONGLE

config ZMK_SPLIT
    default y

config ZMK_BLE
    default y

endif
```

## boards/shields/totemish/Kconfig.shield
```kconfig
config SHIELD_TOTEMish_LEFT
    def_bool $(shields_list_contains,totemish_left)

config SHIELD_TOTEMish_RIGHT
    def_bool $(shields_list_contains,totemish_right)
```
